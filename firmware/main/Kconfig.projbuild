## firmware/main/Kconfig.projbuild
```kconfig
menu "M2smart"

    choice M2_BOARD
        prompt "Board"
        default M2_BOARD_DEVKIT
        help
            The PCB model this firmware is built for (main/board.c, docs/board-lineup.md).
            firmware/build.sh <board> chooses it.
        config M2_BOARD_DEVKIT
            bool "DevKit test board, 2 channels (ESP32)"
        config M2_BOARD_T1
            bool "Touch switch, 1 key (ESP32-C3)"
        config M2_BOARD_T2
            bool "Touch switch, 2 keys (ESP32-C3)"
        config M2_BOARD_T3
            bool "Touch switch, 3 keys (ESP32-C3)"
        config M2_BOARD_T4
            bool "Touch switch, 4 keys (ESP32-C3)"
        config M2_BOARD_R8
            bool "8-relay panel board (ESP32)"
        config M2_BOARD_SK
            bool "Smart socket (ESP32-C3)"
        config M2_BOARD_DO
            bool "Door opener (ESP32-C3)"
        config M2_BOARD_PM
            bool "Water pump (ESP32-C3)"
        config M2_BOARD_D1
            bool "Dimmer, 1 channel (ESP32-C3)"
        config M2_BOARD_D2
            bool "Dimmer, 2 channels (ESP32-C3)"
        config M2_BOARD_CL
            bool "Evaporative cooler (ESP32-C3)"
        config M2_BOARD_FN
            bool "Fan (ESP32-C3)"
        config M2_BOARD_CU
            bool "Curtain (ESP32-C3)"
        config M2_BOARD_GD
            bool "Parking door (ESP32-C3)"
        config M2_BOARD_CT
            bool "Door and window contact (ESP32-C3)"
        config M2_BOARD_LK
            bool "Water leak (ESP32-C3)"
        config M2_BOARD_SM
            bool "Smoke (ESP32-C3)"
        config M2_BOARD_PR
            bool "Presence, mmWave (ESP32-C3)"
        config M2_BOARD_RS
            bool "Room sensor (ESP32-C3)"
        config M2_BOARD_RSAIR
            bool "Room sensor with air quality (ESP32-C3)"
        config M2_BOARD_CO
            bool "Carbon monoxide (ESP32-C3)"
        config M2_BOARD_AL
            bool "Alarm panel (ESP32)"
        config M2_BOARD_CAM
            bool "Camera (ESP32-CAM)"
        config M2_BOARD_EM
            bool "Whole-home energy meter (ESP32-C3)"
    endchoice

    menu "Energy meter calibration"
        depends on M2_BOARD_EM
        help
            The BL0942's register counts per unit, times 1000, for this PCB's burden resistor
            and voltage divider. Measure once per batch against a known load (e.g. a 1000 W
            heater) and a reference meter, then set them here (docs/board-lineup.md, M2-EM).
        config M2_METER_COUNTS_PER_VOLT
            int "Counts per volt x 1000"
            default 15873359
        config M2_METER_COUNTS_PER_AMP
            int "Counts per ampere x 1000"
            default 251213465
        config M2_METER_COUNTS_PER_WATT
            int "Counts per watt x 1000"
            default 596000
    endmenu

    config M2_API_URL
        string "Server address"
        default "https://m2smart.ir"
        help
            The web app's address; the board claims at <address>/api/v1/boards/claim.

    config M2_MQTT_URL
        string "Broker address"
        default "mqtts://mqtt.m2smart.ir:8883"
        help
            The boards' MQTT broker. mqtts:// is checked against certs/board_ca.pem.

    config M2_DEV_INSECURE
        bool "Allow http:// and mqtt:// (development only)"
        default n
        help
            For a DevKit against the development stack on a PC. Never in production.

    choice M2_KEYS
        prompt "DevKit keys"
        depends on M2_BOARD_DEVKIT
        default M2_KEYS_TTP223
        config M2_KEYS_TTP223
            bool "TTP223 touch keys (output high while touched)"
        config M2_KEYS_BUTTON
            bool "Push buttons to GND (internal pull-up)"
    endchoice

endmenu
```
